## CMakeLists.txt
```
# SPDX-License-Identifier: Apache-2.0
# Copyright 2026 Gigaspark OS

cmake_minimum_required(VERSION 3.20.0)

find_package(Zephyr REQUIRED HINTS $ENV{ZEPHYR_BASE})
project(gigaspark_m4)

# Strict compilation: treat all warnings as errors (Fase 18)
target_compile_options(app PRIVATE -Werror -Wall -Wextra)

target_sources(app PRIVATE
	src/main.c
	src/mem_engine.c
	src/zram_comp.c
	src/sd_swap.c
	src/fs_manager.c
)
target_include_directories(app PRIVATE
	${CMAKE_CURRENT_SOURCE_DIR}
	${CMAKE_CURRENT_SOURCE_DIR}/../common
	${CMAKE_CURRENT_SOURCE_DIR}/../common/include
)
```

## prj.conf
```kconfig
# Gigaspark OS - M4 (Remote Core) Configuration
CONFIG_PRINTK=y
CONFIG_LOG=y
CONFIG_LOG_TIMESTAMP_64BIT=y
CONFIG_LOG_THREAD_ID_PREFIX=y
CONFIG_LOG_BACKEND_SHOW_COLOR=y
CONFIG_LOG_PROCESS_THREAD_STACK_SIZE=2048
CONFIG_HEAP_MEM_POOL_SIZE=8192
CONFIG_MAIN_STACK_SIZE=4096

# IPC Service
CONFIG_IPC_SERVICE=y
CONFIG_OPENAMP=y
CONFIG_OPENAMP_MASTER=n

# MBOX driver for STM32 HSEM
CONFIG_MBOX=y

# SPI driver for SD card
CONFIG_SPI=y

# Disk access (SD card)
CONFIG_DISK_ACCESS=y

# Filesystem
CONFIG_FILE_SYSTEM=y
CONFIG_FAT_FILESYSTEM_ELM=y
CONFIG_FS_FATFS_LFN=y
CONFIG_FILE_SYSTEM_MAX_FILE_NAME=24
CONFIG_FS_FATFS_CUSTOM_MOUNT_POINT_COUNT=1
```

## arduino_giga_r1_m4.overlay
```dts
/*
 * Gigaspark OS - M4 Device Tree Overlay
 * Arduino Giga R1 (STM32H747XI M4)
 *
 * IPC via OpenAMP static vrings over SRAM4
 * SPI1 with MicroSD card (D11 MOSI, D12 MISO, D13 SCK, D10 CS)
 */

#include <zephyr/dt-bindings/ipc_service/static_vrings.h>
#include <zephyr/dt-bindings/memory-attr/memory-attr-arm.h>

/ {
	/* SRAM4: 64KB at 0x38000000 (D3 domain, shared between M7 and M4) */
	sram4_ipc: memory@38000000 {
		compatible = "zephyr,memory-region", "mmio-sram";
		reg = <0x38000000 DT_SIZE_K(64)>;
		zephyr,memory-region = "SRAM4_IPC";
		zephyr,memory-attr = <DT_MEM_ARM(ATTR_MPU_RAM)>;
	};

	/* IPC node for OpenAMP static vrings */
	ipc {
		ipc0: ipc0 {
			compatible = "zephyr,ipc-openamp-static-vrings";
			memory-region = <&sram4_ipc>;
			mboxes = <&mailbox 1>, <&mailbox 0>;
			mbox-names = "tx", "rx";
			role = "remote";
			zephyr,buffer-size = <1024>;
			status = "okay";
		};
	};
};
```

## src/main.c
```c
/*
 * Gigaspark OS - M4 Remote Core
 * STM32H747XI Cortex-M4 @ 240MHz
 *
 * Architecture: 2 Dedicated Threads (Strict Multiplexation)
 *
 * Thread 1 - ipc_listener (Priority: High):
 *   EXCLUSIVELY receives RPMsg messages and queues commands.
 *   EXCLUSIVELY sends responses back to M7.
 *   Never processes commands directly.
 *
 * Thread 2 - mem_engine (Priority: Medium):
 *   EXCLUSIVELY processes commands from the queue.
 *   Runs all compression, decompression, SD swap, and filesystem ops.
 *   Puts responses into resp_msgq for ipc_listener to send.
 *
 * Communication: k_msgq between ISR callback and mem_engine thread.
 * If mem_engine is compressing a 1KB block, ipc_listener
 * keeps receiving new commands without blocking.
 */

#include <zephyr/kernel.h>
#include <zephyr/device.h>
#include <zephyr/ipc/ipc_service.h>
#include <zephyr/logging/log.h>

#include "ipc_config.h"
#include "ipc_protocol.h"
#include "mem_engine.h"
#include "fs_manager.h"

LOG_MODULE_REGISTER(gigaspark_m4, CONFIG_LOG_DEFAULT_LEVEL);

/* ============================================================
 * Shared State
 * ============================================================ */

#define CMD_QUEUE_SIZE  8

/* Request item for the command queue */
struct cmd_item {
	struct ipc_msg req;
};

/* Message queues */
K_MSGQ_DEFINE(cmd_msgq, sizeof(struct cmd_item), CMD_QUEUE_SIZE, 1);
K_MSGQ_DEFINE(resp_msgq, sizeof(struct ipc_msg), CMD_QUEUE_SIZE, 1);

/* Semaphores */
static K_SEM_DEFINE(bound_sem, 0, 1);
static K_SEM_DEFINE(cmd_sem, 0, CMD_QUEUE_SIZE);
static K_SEM_DEFINE(resp_sem, 0, CMD_QUEUE_SIZE);

/* IPC endpoint */
static struct ipc_ept ept;
static volatile bool ept_ready;

/* Buffers for IPC responses (owned by mem_engine thread) */
static uint8_t io_buf[MEM_IO_MAX];
static uint8_t app_buf[APP_BINARY_MAX_SIZE];
uint8_t g_file_write_buf[FILE_WRITE_CHUNK_MAX];
uint8_t g_media_read_buf[MEDIA_READ_CHUNK_MAX];

/* ============================================================
 * IPC Callbacks (run in ISR context, must be FAST)
 * ============================================================ */

static void ept_bound(void *priv)
{
	(void)priv;
	ept_ready = true;
	k_sem_give(&bound_sem);
	LOG_INF("Endpoint bound to M7");
}

static void ept_received(const void *data, size_t len, void *priv)
{
	(void)priv;
	if (len < sizeof(struct ipc_msg)) {
		return;
	}

	/* Copy the message into our queue item (safe from ISR) */
	struct cmd_item item;
	memcpy(&item.req, data, sizeof(struct ipc_msg));

	/* Non-blocking put into the queue */
	int ret = k_msgq_put(&cmd_msgq, &item, K_NO_WAIT);
	if (ret < 0) {
		LOG_WRN("Command queue full, dropping cmd 0x%02x", item.req.cmd);
		return;
	}

	/* Signal the mem_engine thread */
	k_sem_give(&cmd_sem);
}

/* IPC endpoint configuration */
static struct ipc_ept_cfg ept_cfg = {
	.name = IPC_ENDPOINT_NAME,
	.cb = {
		.bound    = ept_bound,
		.received = ept_received,
	},
};

/* ============================================================
 * IPC Listener Thread (High Priority = 5)
 * Receives RPMsg, queues commands, sends responses.
 * ============================================================ */

static void ipc_listener_thread(void *p1, void *p2, void *p3)
{
	(void)p1; (void)p2; (void)p3;
	const struct device *ipc_instance;
	int ret;

	LOG_INF("IPC Listener starting...");

	/* Initialize IPC */
	ipc_instance = DEVICE_DT_GET(DT_NODELABEL(ipc0));

	ret = ipc_service_open_instance(ipc_instance);
	if (ret < 0 && ret != -EALREADY) {
		LOG_ERR("Failed to open IPC instance: %d", ret);
		return;
	}

	ret = ipc_service_register_endpoint(ipc_instance, &ept, &ept_cfg);
	if (ret < 0) {
		LOG_ERR("Failed to register endpoint: %d", ret);
		return;
	}

	LOG_INF("Waiting for M7 handshake...");
	k_sem_take(&bound_sem, K_FOREVER);
	LOG_INF("M4 IPC Listener ready.");

	/* Main loop: send responses that mem_engine has prepared */
	while (1) {
		/* Wait for mem_engine to signal a response is ready */
		k_sem_take(&resp_sem, K_FOREVER);

		struct ipc_msg resp;
		if (k_msgq_get(&resp_msgq, &resp, K_NO_WAIT) == 0) {
			ret = ipc_service_send(&ept, &resp, sizeof(resp));
			if (ret < 0) {
				LOG_ERR("Failed to send response: %d", ret);
			}
		}
	}
}

/* Static thread: IPC listener, high priority (PRIORITY=5) */
K_THREAD_DEFINE(ipc_listener_tid, 2048,
		ipc_listener_thread, NULL, NULL, NULL,
		5, 0, 0);

/* ============================================================
 * Memory Engine Thread (Medium Priority = 7)
 * Reads commands from queue, processes them, sends responses.
 * All heavy work (compress, decompress, swap, filesystem) runs here.
 * ============================================================ */

static void process_command(const struct ipc_msg *req, struct ipc_msg *resp)
{
	resp->cmd = CMD_RESPONSE;

	switch (req->cmd) {
	case CMD_ALLOC: {
		uint16_t handle = mem_alloc(req->size);
		resp->status = (handle != MEM_HANDLE_INVALID)
			       ? STATUS_OK : STATUS_ERR_NOMEM;
		resp->handle = handle;
		resp->size = req->size;
		LOG_INF("CMD_ALLOC size=%u -> handle=0x%04x", req->size, handle);
		break;
	}
	case CMD_FREE: {
		int ret = mem_free(req->handle);
		resp->status = (ret == 0) ? STATUS_OK : STATUS_ERR_BAD_HANDLE;
		resp->handle = req->handle;
		resp->size = 0;
		LOG_INF("CMD_FREE handle=0x%04x -> %d", req->handle, ret);
		break;
	}
	case CMD_READ: {
		size_t to_read = req->size;
		if (to_read > MEM_IO_MAX) {
			to_read = MEM_IO_MAX;
		}
		size_t actual = mem_read(req->handle, io_buf, to_read);
		resp->handle = req->handle;
		resp->size = actual;
		resp->status = (actual > 0) ? STATUS_OK : STATUS_ERR_READ_FAILED;
		LOG_INF("CMD_READ handle=0x%04x -> %u bytes", req->handle, actual);
		break;
	}
	case CMD_WRITE: {
		int ret = mem_write(req->handle, &req->size, sizeof(req->size));
		resp->status = (ret == 0) ? STATUS_OK : STATUS_ERR_WRITE_FAILED;
		resp->handle = req->handle;
		resp->size = 0;
		LOG_INF("CMD_WRITE handle=0x%04x -> %d", req->handle, ret);
		break;
	}
	case CMD_GET_APP_LIST: {
		int count = fs_get_app_count();
		resp->status = (count > 0) ? STATUS_OK : STATUS_ERR_NO_APPS;
		resp->size = count;
		resp->handle = 0;
		LOG_INF("CMD_GET_APP_LIST -> %d apps", count);
		break;
	}
	case CMD_LOAD_APP: {
		uint8_t app_id = (uint8_t)(req->handle & 0xFF);
		size_t loaded = fs_load_app(app_id, app_buf, sizeof(app_buf));

		if (loaded == 0) {
			resp->status = STATUS_ERR_APP_NOT_FOUND;
			resp->handle = MEM_HANDLE_INVALID;
			resp->size = 0;
			LOG_INF("CMD_LOAD_APP id=%u -> NOT FOUND", app_id);
		} else {
			uint16_t mem_handle = mem_alloc(loaded);
			if (mem_handle == MEM_HANDLE_INVALID) {
				resp->status = STATUS_ERR_NOMEM;
				resp->handle = MEM_HANDLE_INVALID;
				resp->size = 0;
				LOG_INF("CMD_LOAD_APP id=%u -> NO MEMORY", app_id);
			} else {
				mem_write(mem_handle, app_buf, loaded);
				resp->status = STATUS_OK;
				resp->handle = mem_handle;
				resp->size = loaded;
				LOG_INF("CMD_LOAD_APP id=%u -> handle=0x%04x size=%u",
					app_id, mem_handle, loaded);
			}
		}
		break;
	}
	case CMD_FILE_OPEN: {
		char filename[32];
		snprintf(filename, sizeof(filename), "app_%04x.bin", req->handle);

		int fd = fs_file_open(filename);
		if (fd >= 0) {
			resp->status = STATUS_OK;
			resp->handle = (uint16_t)fd;
			resp->size = 0;
			LOG_INF("CMD_FILE_OPEN %s -> fd=%d", filename, fd);
		} else {
			resp->status = STATUS_ERR_FILE_OPEN;
			resp->handle = MEM_HANDLE_INVALID;
			resp->size = 0;
			LOG_ERR("CMD_FILE_OPEN %s -> %d", filename, fd);
		}
		break;
	}
	case CMD_FILE_WRITE: {
		extern uint8_t g_file_write_buf[FILE_WRITE_CHUNK_MAX];

		int written = fs_file_write(req->handle, g_file_write_buf, req->size);
		if (written > 0) {
			resp->status = STATUS_OK;
			resp->size = written;
		} else {
			resp->status = STATUS_ERR_FILE_WRITE;
			resp->size = 0;
			LOG_ERR("CMD_FILE_WRITE fd=%d -> %d", req->handle, written);
		}
		break;
	}
	case CMD_FILE_CLOSE: {
		int ret = fs_file_close(req->handle);
		if (ret == 0) {
			resp->status = STATUS_OK;
			LOG_INF("CMD_FILE_CLOSE fd=%d -> OK", req->handle);
		} else {
			resp->status = STATUS_ERR_FILE_CLOSE;
			LOG_ERR("CMD_FILE_CLOSE fd=%d -> %d", req->handle, ret);
		}
		break;
	}
	case CMD_MEDIA_OPEN: {
		/* El nombre del archivo viene en el campo handle como indice
		 * simplificado. En un caso real se enviaria en el payload. */
		char filename[32];
		snprintf(filename, sizeof(filename), "media_%04x.dat", req->handle);

		int fd = fs_media_open(filename);
		if (fd >= 0) {
			resp->status = STATUS_OK;
			resp->handle = (uint16_t)fd;
			resp->size = 0;
			LOG_INF("CMD_MEDIA_OPEN %s -> fd=%d", filename, fd);
		} else {
			resp->status = STATUS_ERR_MEDIA_OPEN;
			resp->handle = MEM_HANDLE_INVALID;
			LOG_ERR("CMD_MEDIA_OPEN %s -> %d", filename, fd);
		}
		break;
	}
	case CMD_MEDIA_READ: {
		extern uint8_t g_media_read_buf[MEDIA_READ_CHUNK_MAX];

		size_t bytes_read = 0;
		int ret = fs_media_read(req->handle, g_media_read_buf,
					req->size, &bytes_read);
		if (ret == 0 && bytes_read > 0) {
			resp->status = STATUS_OK;
			resp->size = bytes_read;
		} else {
			resp->status = STATUS_ERR_MEDIA_READ;
			resp->size = 0;
		}
		break;
	}
	case CMD_MEDIA_SEEK: {
		/* offset en resp->size, whence en resp->handle (0=SET,1=CUR,2=END) */
		int ret = fs_media_seek(req->handle, (int32_t)req->size,
					req->handle & 0xFF);
		if (ret == 0) {
			resp->status = STATUS_OK;
			LOG_INF("CMD_MEDIA_SEEK fd=%d offset=%d -> OK",
				req->handle, req->size);
		} else {
			resp->status = STATUS_ERR_MEDIA_SEEK;
			LOG_ERR("CMD_MEDIA_SEEK fd=%d -> %d", req->handle, ret);
		}
		break;
	}
	case CMD_MEDIA_CLOSE: {
		int ret = fs_media_close(req->handle);
		if (ret == 0) {
			resp->status = STATUS_OK;
			LOG_INF("CMD_MEDIA_CLOSE fd=%d -> OK", req->handle);
		} else {
			resp->status = STATUS_ERR_MEDIA_CLOSE;
			LOG_ERR("CMD_MEDIA_CLOSE fd=%d -> %d", req->handle, ret);
		}
		break;
	}
	default:
		LOG_WRN("Unknown cmd: 0x%02x", req->cmd);
		resp->status = STATUS_ERR_BAD_HANDLE;
		resp->handle = MEM_HANDLE_INVALID;
		resp->size = 0;
		break;
	}
}

static void mem_engine_thread(void *p1, void *p2, void *p3)
{
	(void)p1; (void)p2; (void)p3;
	struct cmd_item item;
	struct ipc_msg resp;
	int ret;

	LOG_INF("Memory Engine thread starting...");

	while (1) {
		/* Block until a command arrives in the queue */
		ret = k_sem_take(&cmd_sem, K_FOREVER);
		if (ret != 0) {
			continue;
		}

		/* Get the command from the queue */
		ret = k_msgq_get(&cmd_msgq, &item, K_NO_WAIT);
		if (ret != 0) {
			continue;
		}

		LOG_DBG("Processing cmd 0x%02x", item.req.cmd);

		/* Process the command (this is where heavy work happens) */
		process_command(&item.req, &resp);

		/* Put response in the response queue */
		ret = k_msgq_put(&resp_msgq, &resp, K_NO_WAIT);
		if (ret < 0) {
			LOG_ERR("Response queue full, dropping response");
			continue;
		}

		/* Signal the IPC listener to send the response */
		k_sem_give(&resp_sem);
	}
}

/* Static thread: Memory engine, medium priority (PRIORITY=7) */
K_THREAD_DEFINE(mem_engine_tid, 4096,
		mem_engine_thread, NULL, NULL, NULL,
		7, 0, 0);

/* ============================================================
 * Main (Initialization Only)
 * Initializes hardware and subsystems, then the threads take over.
 * main() thread has lowest priority and does nothing after init.
 * ============================================================ */

int main(void)
{
	int ret;

	LOG_INF("Gigaspark OS M4 Remote Core starting...");
	LOG_INF("Architecture: 2 dedicated threads (ipc_listener + mem_engine)");

	/* Initialize memory engine (includes SD swap init) */
	mem_init();

	/* Initialize filesystem manager (mount SD, scan apps) */
	ret = fs_init();
	if (ret < 0) {
		LOG_WRN("Filesystem init failed: %d (SD not available)", ret);
	} else {
		LOG_INF("Filesystem ready, %d app(s) found", fs_get_app_count());
	}

	LOG_INF("M4 subsystems initialized. Threads are now running.");
	LOG_INF("  ipc_listener: tid=%d, prio=5 (HIGH)", (int)ipc_listener_tid);
	LOG_INF("  mem_engine:   tid=%d, prio=7 (MEDIUM)", (int)mem_engine_tid);

	/* main() thread sleeps forever - threads do all the work */
	return 0;
}
```

## src/fs_manager.c
```c
/*
 * Gigaspark OS - File System Manager Implementation
 * SD card access via SPI + FAT32 filesystem
 *
 * Mounts the SD card at /SD: and scans /apps/ directory
 * for .bin application files. Provides an API to list and
 * load apps for the M7 launcher.
 */

#include "fs_manager.h"
#include "ipc_protocol.h"

#include <zephyr/kernel.h>
#include <zephyr/fs/fs.h>
#include <zephyr/logging/log.h>
#include <string.h>

LOG_MODULE_REGISTER(fs_manager, CONFIG_LOG_DEFAULT_LEVEL);

/* Mount point */
#define SD_MOUNT_POINT  "/SD:"

/* Apps directory */
#define APPS_DIR        "/SD:/apps"

/* Forward declaration */
static int fs_scan_apps(void);

/* Static app list */
static struct app_info app_list[APP_MAX_COUNT];
static int app_count = 0;
static bool fs_mounted = false;

int fs_init(void)
{
	int ret;

	memset(app_list, 0, sizeof(app_list));
	app_count = 0;

	/* Mount the SD card FAT32 filesystem */
	static struct fs_mount_t mount_point = {
		.type = FS_FATFS,
		.mnt_point = SD_MOUNT_POINT,
		.fs_data = NULL,
		.storage_dev = NULL,
		.flags = 0,
	};

	ret = fs_mount(&mount_point);
	if (ret < 0) {
		LOG_WRN("SD mount failed: %d (no SD card?)", ret);
		fs_mounted = false;
		return ret;
	}

	fs_mounted = true;
	LOG_INF("SD card mounted at %s", SD_MOUNT_POINT);

	/* Scan /apps/ directory for .bin files */
	ret = fs_scan_apps();
	if (ret < 0) {
		LOG_WRN("App scan failed: %d", ret);
	}

	return 0;
}

static int fs_scan_apps(void)
{
	int ret;
	struct fs_dir_t dir_entry;
	struct fs_dirent entry;

	if (!fs_mounted) {
		return -ENODEV;
	}

	memset(&dir_entry, 0, sizeof(dir_entry));
	app_count = 0;

	ret = fs_opendir(&dir_entry, APPS_DIR);
	if (ret < 0) {
		LOG_WRN("Cannot open %s: %d", APPS_DIR, ret);
		return ret;
	}

	LOG_INF("Scanning %s for apps...", APPS_DIR);

	while (1) {
		ret = fs_readdir(&dir_entry, &entry);
		if (ret < 0) {
			LOG_WRN("readdir error: %d", ret);
			break;
		}

		/* End of directory */
		if (entry.name[0] == '\0') {
			break;
		}

		/* Skip directories */
		if (entry.type != FS_DIR_ENTRY_FILE) {
			continue;
		}

		/* Check for .bin extension */
		size_t name_len = strlen(entry.name);
		if (name_len < 5) {
			continue;
		}

		if (strcmp(&entry.name[name_len - 4], ".bin") != 0) {
			continue;
		}

		/* Found a .bin file - add to app list */
		if (app_count >= APP_MAX_COUNT) {
			LOG_WRN("Too many apps, skipping %s", entry.name);
			break;
		}

		app_list[app_count].id = app_count;

		/* Copy name without .bin extension */
		size_t copy_len = name_len - 4;
		if (copy_len >= APP_NAME_MAX) {
			copy_len = APP_NAME_MAX - 1;
		}
		memcpy(app_list[app_count].name, entry.name, copy_len);
		app_list[app_count].name[copy_len] = '\0';

		LOG_INF("  App[%d]: %s", app_count, app_list[app_count].name);
		app_count++;
	}

	fs_closedir(&dir_entry);
	LOG_INF("Found %d app(s)", app_count);

	return 0;
}

int fs_get_app_count(void)
{
	return app_count;
}

int fs_get_app_list(struct app_info *out, int max)
{
	if (!fs_mounted || out == NULL || max <= 0) {
		return 0;
	}

	int count = (app_count < max) ? app_count : max;
	memcpy(out, app_list, count * sizeof(struct app_info));
	return count;
}

size_t fs_load_app(uint8_t id, uint8_t *buf, size_t buf_size)
{
	if (!fs_mounted || id >= app_count || buf == NULL || buf_size == 0) {
		return 0;
	}

	/* Build full path */
	char path[64];
	snprintf(path, sizeof(path), "%s/%s.bin", APPS_DIR, app_list[id].name);

	struct fs_file_t file;
	memset(&file, 0, sizeof(file));

	int ret = fs_open(&file, path, FS_O_READ);
	if (ret < 0) {
		LOG_ERR("Cannot open %s: %d", path, ret);
		return 0;
	}

	/* Get file size */
	struct fs_dirent entry;
	ret = fs_stat(path, &entry);
	if (ret < 0) {
		LOG_ERR("Cannot stat %s: %d", path, fs_close(&file));
		return 0;
	}

	size_t file_size = entry.size;
	if (file_size > buf_size) {
		LOG_WRN("File %s too large (%zu > %zu)", path, file_size, buf_size);
		file_size = buf_size;
	}

	/* Read the file */
	ssize_t bytes_read = fs_read(&file, buf, file_size);
	fs_close(&file);

	if (bytes_read < 0) {
		LOG_ERR("Read error for %s: %d", path, (int)bytes_read);
		return 0;
	}

	LOG_INF("Loaded %s: %d bytes", path, (int)bytes_read);
	return (size_t)bytes_read;
}

int fs_is_ready(void)
{
	return fs_mounted ? 0 : -ENODEV;
}

/* ---- File Write Support ---- */

/* Open file descriptors (simple: only 1 at a time) */
static struct fs_file_t write_files[1];
static bool write_file_open[1] = { false };

int fs_file_open(const char *filename)
{
	if (!fs_mounted || filename == NULL) {
		return -ENODEV;
	}

	/* Find free slot */
	int fd = -1;
	for (int i = 0; i < 1; i++) {
		if (!write_file_open[i]) {
			fd = i;
			break;
		}
	}

	if (fd < 0) {
		LOG_ERR("No free file descriptors");
		return -ENOMEM;
	}

	/* Build full path */
	char path[64];
	snprintf(path, sizeof(path), "%s/%s", APPS_DIR, filename);

	/* Open file for writing */
	memset(&write_files[fd], 0, sizeof(write_files[fd]));
	int ret = fs_open(&write_files[fd], path, FS_O_CREATE | FS_O_WRITE);
	if (ret < 0) {
		LOG_ERR("Cannot open %s for writing: %d", path, ret);
		return ret;
	}

	write_file_open[fd] = true;
	LOG_INF("File opened for writing: %s (fd=%d)", path, fd);
	return fd;
}

int fs_file_write(int fd, const uint8_t *data, size_t len)
{
	if (fd < 0 || fd >= 1 || !write_file_open[fd]) {
		return -EBADF;
	}

	if (data == NULL || len == 0) {
		return -EINVAL;
	}

	ssize_t written = fs_write(&write_files[fd], data, len);
	if (written < 0) {
		LOG_ERR("Write error: %d", (int)written);
		return (int)written;
	}

	LOG_DBG("Wrote %d bytes to fd %d", (int)written, fd);
	return (int)written;
}

int fs_file_close(int fd)
{
	if (fd < 0 || fd >= 1 || !write_file_open[fd]) {
		return -EBADF;
	}

	int ret = fs_close(&write_files[fd]);
	write_file_open[fd] = false;

	if (ret < 0) {
		LOG_ERR("Close error: %d", ret);
		return ret;
	}

	LOG_INF("File closed: fd=%d", fd);
	return 0;
}

/* ---- Media Read Support ---- */

/* Archivos multimedia abiertos para lectura */
#define MEDIA_FD_MAX  2
static struct fs_file_t media_files[MEDIA_FD_MAX];
static bool media_file_open[MEDIA_FD_MAX] = { false, false };

int fs_media_open(const char *filename)
{
	if (!fs_mounted || filename == NULL) {
		return -ENODEV;
	}

	/* Buscar slot libre */
	int fd = -1;
	for (int i = 0; i < MEDIA_FD_MAX; i++) {
		if (!media_file_open[i]) {
			fd = i;
			break;
		}
	}

	if (fd < 0) {
		LOG_ERR("No hay descriptors multimedia libres");
		return -ENOMEM;
	}

	/* Construir ruta completa */
	char path[64];
	snprintf(path, sizeof(path), "%s%s", SD_MEDIA_PATH, filename);

	/* Abrir para lectura */
	memset(&media_files[fd], 0, sizeof(media_files[fd]));
	int ret = fs_open(&media_files[fd], path, FS_O_READ);
	if (ret < 0) {
		LOG_ERR("No se pudo abrir %s: %d", path, ret);
		return ret;
	}

	media_file_open[fd] = true;
	LOG_INF("Media abierto: %s (fd=%d)", path, fd);
	return fd;
}

int fs_media_read(int fd, uint8_t *buf, size_t buf_size, size_t *bytes_read)
{
	if (fd < 0 || fd >= MEDIA_FD_MAX || !media_file_open[fd]) {
		return -EBADF;
	}

	if (buf == NULL || buf_size == 0 || bytes_read == NULL) {
		return -EINVAL;
	}

	/* Leer chunk alineado a 32 bytes para DMA/DCACHE */
	size_t aligned_size = (buf_size + 31) & ~31;
	if (aligned_size > buf_size) {
		aligned_size = buf_size;
	}

	ssize_t result = fs_read(&media_files[fd], buf, aligned_size);
	if (result < 0) {
		LOG_ERR("Error leyendo media fd=%d: %d", fd, (int)result);
		*bytes_read = 0;
		return (int)result;
	}

	*bytes_read = (size_t)result;
	LOG_DBG("Media read fd=%d: %d bytes", fd, (int)result);
	return 0;
}

int fs_media_seek(int fd, int32_t offset, int whence)
{
	if (fd < 0 || fd >= MEDIA_FD_MAX || !media_file_open[fd]) {
		return -EBADF;
	}

	/* Mapear whence de IPC a Zephyr */
	int fs_whence;
	switch (whence) {
	case 0:  fs_whence = FS_SEEK_SET; break;
	case 1:  fs_whence = FS_SEEK_CUR; break;
	case 2:  fs_whence = FS_SEEK_END; break;
	default: return -EINVAL;
	}

	int ret = fs_seek(&media_files[fd], offset, fs_whence);
	if (ret < 0) {
		LOG_ERR("Seek error fd=%d: %d", fd, ret);
	}
	return ret;
}

int fs_media_close(int fd)
{
	if (fd < 0 || fd >= MEDIA_FD_MAX || !media_file_open[fd]) {
		return -EBADF;
	}

	int ret = fs_close(&media_files[fd]);
	media_file_open[fd] = false;

	if (ret < 0) {
		LOG_ERR("Media close error fd=%d: %d", fd, ret);
	}
	return ret;
}
```

## src/fs_manager.h
```c
/*
 * Gigaspark OS - File System Manager Header
 * SD card access via SPI + FAT32 filesystem
 */

#ifndef GIGASPARK_FS_MANAGER_H
#define GIGASPARK_FS_MANAGER_H

#include <stdint.h>
#include <stddef.h>
#include "ipc_protocol.h"

/*
 * Initialize the filesystem manager.
 * Mounts the SD card at /SD: and scans /apps/ for .bin files.
 *
 * @return  0 on success, negative error code on failure.
 */
int fs_init(void);

/*
 * Get the number of apps found on the SD card.
 *
 * @return  Number of apps (0 if none found or SD not available).
 */
int fs_get_app_count(void);

/*
 * Get the list of apps found on the SD card.
 *
 * @param out   Pointer to array of app_info structs.
 * @param max   Maximum number of apps to return.
 * @return      Number of apps copied to out.
 */
int fs_get_app_list(struct app_info *out, int max);

/*
 * Load an app binary into a buffer.
 *
 * @param id    App id (0-based index).
 * @param buf   Destination buffer.
 * @param buf_size  Size of destination buffer.
 * @return      Number of bytes loaded, or 0 on error.
 */
size_t fs_load_app(uint8_t id, uint8_t *buf, size_t buf_size);

/*
 * Check if the filesystem is ready.
 *
 * @return  0 if ready, negative error code otherwise.
 */
int fs_is_ready(void);

/*
 * Open a file for writing.
 *
 * @param filename  Name of the file (relative to /SD:/apps/).
 * @return          File descriptor (>= 0) or negative error code.
 */
int fs_file_open(const char *filename);

/*
 * Write data to an open file.
 *
 * @param fd    File descriptor from fs_file_open.
 * @param data  Data to write.
 * @param len   Number of bytes to write.
 * @return      Number of bytes written, or negative error code.
 */
int fs_file_write(int fd, const uint8_t *data, size_t len);

/*
 * Close an open file.
 *
 * @param fd    File descriptor from fs_file_open.
 * @return      0 on success, negative error code.
 */
int fs_file_close(int fd);

/* ---- Media Read API ---- */

/*
 * Abrir archivo multimedia para lectura.
 *
 * @param filename  Nombre del archivo (relativo a /SD:/media/).
 * @return          File descriptor (>= 0) o error negativo.
 */
int fs_media_open(const char *filename);

/*
 * Leer chunk de archivo multimedia.
 * Los datos se leen alineados a 32 bytes para DMA/DCACHE.
 *
 * @param fd         File descriptor de fs_media_open.
 * @param buf        Buffer de destino.
 * @param buf_size   Tamano maximo a leer.
 * @param bytes_read Puntero donde almacenar bytes leidos.
 * @return           0 en exito, error negativo.
 */
int fs_media_read(int fd, uint8_t *buf, size_t buf_size, size_t *bytes_read);

/*
 * Mover cursor en archivo multimedia.
 *
 * @param fd      File descriptor.
 * @param offset  Offset en bytes.
 * @param whence  0=SET, 1=CUR, 2=END.
 * @return        0 en exito, error negativo.
 */
int fs_media_seek(int fd, int32_t offset, int whence);

/*
 * Cerrar archivo multimedia.
 *
 * @param fd  File descriptor.
 * @return    0 en exito, error negativo.
 */
int fs_media_close(int fd);

#endif /* GIGASPARK_FS_MANAGER_H */
```

## src/mem_engine.c
```c
/*
 * Gigaspark OS - Motor de Memoria M4 (Fase 16: Buddy Allocator)
 *
 * Asignador buddy O(log N) con coalescing automatico.
 * Pool total: 4KB dividido en bloques binarios (32 a 4096 bytes).
 */

#include "mem_engine.h"

#include <string.h>
#include <zephyr/logging/log.h>

LOG_MODULE_REGISTER(mem_engine, CONFIG_LOG_DEFAULT_LEVEL);

/* ============================================================
 * BUDDY ALLOCATOR
 * ============================================================ */

#define POOL_SIZE    4096
#define MIN_ORDER    5      /* 2^5 = 32 bytes (bloque minimo) */
#define MAX_ORDER    12     /* 2^12 = 4096 bytes (pool completo) */
#define NUM_ORDERS   (MAX_ORDER - MIN_ORDER + 1)  /* 8 niveles */

#define BLOCK_SIZE(order)   (1U << (order))
#define BLOCKS_AT(order)    (POOL_SIZE >> (order))
#define IDX(order)          ((order) - MIN_ORDER)

/* Pool de memoria */
static uint8_t __attribute__((aligned(32))) pool[POOL_SIZE];

/* free_lists[idx][index]: 1 = libre, 0 = ocupado
 * idx = order - MIN_ORDER
 * Indices por nivel:
 *   idx 0 (order 5,  32B):  128 bloques, indices 0..127
 *   idx 1 (order 6,  64B):   64 bloques, indices 0..63
 *   idx 2 (order 7, 128B):   32 bloques, indices 0..31
 *   idx 3 (order 8, 256B):   16 bloques, indices 0..15
 *   idx 4 (order 9, 512B):    8 bloques, indices 0..7
 *   idx 5 (order 10, 1KB):    4 bloques, indices 0..3
 *   idx 6 (order 11, 2KB):    2 bloques, indices 0..1
 *   idx 7 (order 12, 4KB):    1 bloque,  indice 0
 */
static uint8_t free_lists[NUM_ORDERS][128];

/* Tabla de handles */
#define MAX_HANDLES  64

struct handle_entry {
	uint32_t offset;
	uint32_t size;
	uint8_t  order;
	uint8_t  in_use;
};

static struct handle_entry handles[MAX_HANDLES];

/* ============================================================
 * FUNCIONES INTERNAS
 * ============================================================ */

static void buddy_init(void)
{
	memset(handles, 0, sizeof(handles));
	memset(free_lists, 0, sizeof(free_lists));

	/* Un solo bloque libre de orden maximo (4096B) */
	free_lists[IDX(MAX_ORDER)][0] = 1;
}

/*
 * Busca el bloque libre mas pequeno >= min_order.
 * Retorna 0 si encuentra, -1 si no hay.
 * En *order e *index devuelve la posicion en free_lists (valores reales).
 */
static int find_free(int min_order, int *out_order, int *out_index)
{
	for (int o = min_order; o <= MAX_ORDER; o++) {
		int idx = IDX(o);
		int max_idx = BLOCKS_AT(o);
		for (int i = 0; i < max_idx; i++) {
			if (free_lists[idx][i]) {
				*out_order = o;
				*out_index = i;
				return 0;
			}
		}
	}
	return -1;
}

/*
 * Divide recursivamente un bloque desde from_order hasta to_order.
 * Deja el bloque resultante marcado como ocupado.
 * Los bloques hermanos en cada nivel intermedio quedan libres.
 */
static int split_block(int from_order, int to_order, int index)
{
	for (int o = from_order; o > to_order; o--) {
		int idx = IDX(o);
		free_lists[idx][index] = 0;

		/* Crear dos hijos en el nivel inferior */
		int child_idx = IDX(o - 1);
		free_lists[child_idx][index * 2] = 1;
		free_lists[child_idx][index * 2 + 1] = 1;

		/* Bajar por el hijo izquierdo */
		index = index * 2;
	}

	/* Marcar el bloque final como ocupado */
	free_lists[IDX(to_order)][index] = 0;
	return index;
}

/*
 * Combina bloques hermanos libres向上 (coalescing).
 */
static void merge_block(int order, int index)
{
	while (order < MAX_ORDER) {
		int idx = IDX(order);
		int buddy = (index & 1) ? index - 1 : index + 1;
		int max_idx = BLOCKS_AT(order);

		if (buddy >= max_idx) break;
		if (!free_lists[idx][buddy]) break;

		/* Ambos libres: combinar */
		free_lists[idx][index] = 0;
		free_lists[idx][buddy] = 0;

		order++;
		index >>= 1;
		free_lists[IDX(order)][index] = 1;
	}
}

static int alloc_handle(void)
{
	for (int i = 0; i < MAX_HANDLES; i++) {
		if (!handles[i].in_use) return i;
	}
	return -1;
}

/* ============================================================
 * API PUBLICA
 * ============================================================ */

void mem_engine_init(void)
{
	buddy_init();
	LOG_INF("Buddy Allocator: 4KB pool, %d niveles (%u-%u bytes)",
		NUM_ORDERS, BLOCK_SIZE(MIN_ORDER), BLOCK_SIZE(MAX_ORDER));
}

uint32_t mem_alloc(uint32_t size)
{
	if (size == 0 || size > POOL_SIZE) return 0;

	/* Calcular orden minimo necesario */
	int target = MIN_ORDER;
	while (BLOCK_SIZE(target) < size) target++;
	if (target > MAX_ORDER) return 0;

	/* Buscar bloque libre */
	int fo, fi;
	if (find_free(target, &fo, &fi) < 0) return 0;

	/* Dividir hasta el orden deseado */
	int bi = split_block(fo, target, fi);
	uint32_t off = bi * BLOCK_SIZE(target);

	/* Asignar handle */
	int h = alloc_handle();
	if (h < 0) return 0;

	handles[h].offset = off;
	handles[h].size = BLOCK_SIZE(target);
	handles[h].order = target;
	handles[h].in_use = 1;

	return (uint32_t)(h + 1);
}

int mem_free(uint32_t handle)
{
	if (handle == 0 || handle > MAX_HANDLES) return -1;
	int idx = handle - 1;
	if (!handles[idx].in_use) return -1;

	int order = handles[idx].order;
	int bi = handles[idx].offset / handles[idx].size;
	handles[idx].in_use = 0;

	free_lists[IDX(order)][bi] = 1;
	merge_block(order, bi);
	return 0;
}

int mem_get_info(uint32_t handle, uint32_t *addr, uint32_t *size)
{
	if (handle == 0 || handle > MAX_HANDLES) return -1;
	int idx = handle - 1;
	if (!handles[idx].in_use) return -1;
	if (addr) *addr = (uint32_t)&pool[handles[idx].offset];
	if (size) *size = handles[idx].size;
	return 0;
}

uint8_t mem_get_usage(void)
{
	uint32_t used = 0;
	for (int i = 0; i < MAX_HANDLES; i++) {
		if (handles[i].in_use) used += handles[i].size;
	}
	return (uint8_t)((used * 100) / POOL_SIZE);
}

size_t mem_read(uint32_t handle, void *buf, size_t buf_size)
{
	if (handle == 0 || handle > MAX_HANDLES || !buf) return 0;
	int idx = handle - 1;
	if (!handles[idx].in_use) return 0;
	size_t len = (buf_size < handles[idx].size) ? buf_size : handles[idx].size;
	memcpy(buf, &pool[handles[idx].offset], len);
	return len;
}

int mem_write(uint32_t handle, const void *data, size_t data_len)
{
	if (handle == 0 || handle > MAX_HANDLES || !data) return -1;
	int idx = handle - 1;
	if (!handles[idx].in_use) return -1;
	size_t len = (data_len < handles[idx].size) ? data_len : handles[idx].size;
	memcpy(&pool[handles[idx].offset], data, len);
	return 0;
}
```

## src/mem_engine.h
```c
/*
 * Gigaspark OS - Memory Engine Header (Fase 16: Buddy Allocator)
 * Asignador buddy O(log N) con eviccion LRU.
 */

#ifndef GIGASPARK_MEM_ENGINE_H
#define GIGASPARK_MEM_ENGINE_H

#include <stdint.h>
#include <stddef.h>

/*
 * Inicializa el motor de memoria y el buddy allocator.
 * Debe llamarse una vez antes de cualquier operacion alloc/free.
 */
void mem_engine_init(void);

/*
 * Alias para compatibilidad con codigo existente.
 */
#define mem_init mem_engine_init

/*
 * Asigna memoria usando el buddy allocator.
 *
 * @param size  Numero de bytes a asignar (debe ser > 0 y <= 4096).
 * @return      Handle (ID opaco) en exito, o 0 si falla.
 */
uint32_t mem_alloc(uint32_t size);

/*
 * Libera un bloque de memoria previamente asignado.
 *
 * @param handle  Handle retornado por mem_alloc().
 * @return        0 si ok, -1 si falla.
 */
int mem_free(uint32_t handle);

/*
 * Lee datos de un bloque a un buffer.
 *
 * @param handle    Handle retornado por mem_alloc().
 * @param buf       Buffer destino.
 * @param buf_size  Tamano del buffer destino.
 * @return          Numero de bytes leidos, o 0 si error.
 */
size_t mem_read(uint32_t handle, void *buf, size_t buf_size);

/*
 * Escribe datos en un bloque existente.
 *
 * @param handle    Handle retornado por mem_alloc().
 * @param data      Datos fuente a escribir.
 * @param data_len  Numero de bytes a escribir.
 * @return          0 si ok, -1 si error.
 */
int mem_write(uint32_t handle, const void *data, size_t data_len);

/*
 * Obtiene informacion de un handle.
 *
 * @param handle  Handle a consultar.
 * @param addr    Puntero para la direccion (o NULL).
 * @param size    Puntero para el tamano (o NULL).
 * @return        0 si ok, -1 si el handle es invalido.
 */
int mem_get_info(uint32_t handle, uint32_t *addr, uint32_t *size);

/*
 * Retorna el porcentaje de memoria usada (0-100).
 */
uint8_t mem_get_usage(void);

#endif /* GIGASPARK_MEM_ENGINE_H */
```

## src/sd_swap.c
```c
/*
 * Gigaspark OS - SD Swap Implementation
 * Simulated swap to SD card via RAM buffer
 *
 * The Arduino Giga R1's SD card is connected to M7's SDMMC1,
 * so the M4 cannot access it directly. This module simulates
 * the swap using a RAM buffer, proving the 3-tier architecture.
 *
 * To use real SD: implement swap_init() to communicate with M7
 * via IPC for SD sector read/write operations.
 */

#include "sd_swap.h"
#include "ipc_protocol.h"

#include <zephyr/kernel.h>
#include <zephyr/logging/log.h>
#include <string.h>

LOG_MODULE_REGISTER(sd_swap, CONFIG_LOG_DEFAULT_LEVEL);

/* Simulated SD sectors in RAM */
#define SD_SECTOR_SIZE      512
#define SD_MAX_SECTORS      64
#define SD_DATA_MAX         (SD_SECTOR_SIZE - 4)  /* 508 bytes usable per sector */

/* Swap table entry */
struct swap_entry {
	uint16_t handle;
	uint16_t sector;
	uint8_t  sectors_used;
	uint8_t  valid;
};

/* Sector header */
struct __packed swap_sector_header {
	uint16_t handle;
	uint16_t data_len;
};

/* Module state */
static uint8_t sd_sim[SD_MAX_SECTORS][SD_SECTOR_SIZE] __aligned(4);
static struct swap_entry swap_table[SD_MAX_SECTORS];
static uint16_t next_free_sector = 0;
static bool swap_ready = false;

int swap_init(void)
{
	memset(swap_table, 0, sizeof(swap_table));
	memset(sd_sim, 0, sizeof(sd_sim));
	next_free_sector = 0;
	swap_ready = true;

	LOG_INF("SD swap initialized (simulated, %d sectors x %d bytes)",
		SD_MAX_SECTORS, SD_SECTOR_SIZE);

	return 0;
}

int swap_is_available(void)
{
	return swap_ready ? 0 : -ENODEV;
}

static struct swap_entry *find_entry(uint16_t handle)
{
	for (int i = 0; i < SD_MAX_SECTORS; i++) {
		if (swap_table[i].valid && swap_table[i].handle == handle) {
			return &swap_table[i];
		}
	}
	return NULL;
}

static struct swap_entry *find_free_entry(void)
{
	for (int i = 0; i < SD_MAX_SECTORS; i++) {
		if (!swap_table[i].valid) {
			return &swap_table[i];
		}
	}
	return NULL;
}

int swap_write_blob(uint16_t handle, const uint8_t *data, uint16_t data_len)
{
	if (!swap_ready) {
		return -ENODEV;
	}

	/* Check if already exists -> overwrite */
	struct swap_entry *existing = find_entry(handle);
	if (existing) {
		uint16_t sector = existing->sector;
		uint8_t sectors_needed = (data_len + 4 + SD_DATA_MAX - 1) / SD_DATA_MAX;

		/* Write first sector with header */
		memset(sd_sim[sector], 0, SD_SECTOR_SIZE);
		struct swap_sector_header *hdr = (struct swap_sector_header *)sd_sim[sector];
		hdr->handle = handle;
		hdr->data_len = data_len;

		uint16_t to_copy = (data_len > SD_DATA_MAX) ? SD_DATA_MAX : data_len;
		memcpy(sd_sim[sector] + 4, data, to_copy);

		/* Write additional sectors */
		uint16_t offset = to_copy;
		for (uint8_t s = 1; s < sectors_needed && offset < data_len; s++) {
			memset(sd_sim[sector + s], 0, SD_SECTOR_SIZE);
			to_copy = (data_len - offset > SD_DATA_MAX)
				  ? SD_DATA_MAX : (data_len - offset);
			memcpy(sd_sim[sector + s], data + offset, to_copy);
			offset += to_copy;
		}

		existing->sectors_used = sectors_needed;
		LOG_INF("swap_write: handle=0x%04x sector=%u sectors=%u len=%u",
			handle, sector, sectors_needed, data_len);
		return sector;
	}

	/* Allocate new sectors */
	uint8_t sectors_needed = (data_len + 4 + SD_DATA_MAX - 1) / SD_DATA_MAX;

	if (next_free_sector + sectors_needed > SD_MAX_SECTORS) {
		LOG_WRN("swap_write: SD full, need %u sectors", sectors_needed);
		return -1;
	}

	struct swap_entry *entry = find_free_entry();
	if (!entry) {
		LOG_WRN("swap_write: swap table full");
		return -1;
	}

	uint16_t sector = next_free_sector;
	next_free_sector += sectors_needed;

	/* Write first sector with header */
	memset(sd_sim[sector], 0, SD_SECTOR_SIZE);
	struct swap_sector_header *hdr = (struct swap_sector_header *)sd_sim[sector];
	hdr->handle = handle;
	hdr->data_len = data_len;

	uint16_t to_copy = (data_len > SD_DATA_MAX) ? SD_DATA_MAX : data_len;
	memcpy(sd_sim[sector] + 4, data, to_copy);

	/* Write additional sectors */
	uint16_t offset = to_copy;
	for (uint8_t s = 1; s < sectors_needed && offset < data_len; s++) {
		memset(sd_sim[sector + s], 0, SD_SECTOR_SIZE);
		to_copy = (data_len - offset > SD_DATA_MAX)
			  ? SD_DATA_MAX : (data_len - offset);
		memcpy(sd_sim[sector + s], data + offset, to_copy);
		offset += to_copy;
	}

	entry->handle = handle;
	entry->sector = sector;
	entry->sectors_used = sectors_needed;
	entry->valid = 1;

	LOG_INF("swap_write: handle=0x%04x -> sector=%u sectors=%u len=%u",
		handle, sector, sectors_needed, data_len);
	return sector;
}

size_t swap_read_blob(uint16_t handle, uint8_t *buf, size_t buf_size)
{
	if (!swap_ready) {
		return 0;
	}

	struct swap_entry *entry = find_entry(handle);
	if (!entry) {
		LOG_WRN("swap_read: handle 0x%04x not in swap table", handle);
		return 0;
	}

	struct swap_sector_header *hdr =
		(struct swap_sector_header *)sd_sim[entry->sector];
	uint16_t data_len = hdr->data_len;

	if (data_len > buf_size) {
		LOG_WRN("swap_read: buffer too small (%zu < %u)", buf_size, data_len);
		return 0;
	}

	/* Copy first sector data */
	uint16_t to_copy = (data_len > SD_DATA_MAX) ? SD_DATA_MAX : data_len;
	memcpy(buf, sd_sim[entry->sector] + 4, to_copy);

	/* Read additional sectors */
	uint16_t offset = to_copy;
	for (uint8_t s = 1; s < entry->sectors_used && offset < data_len; s++) {
		to_copy = (data_len - offset > SD_DATA_MAX)
			  ? SD_DATA_MAX : (data_len - offset);
		memcpy(buf + offset, sd_sim[entry->sector + s], to_copy);
		offset += to_copy;
	}

	LOG_INF("swap_read: handle=0x%04x -> %u bytes from sector %u",
		handle, data_len, entry->sector);
	return data_len;
}

int swap_remove_blob(uint16_t handle)
{
	struct swap_entry *entry = find_entry(handle);
	if (!entry) {
		return -1;
	}

	LOG_INF("swap_remove: handle=0x%04x sector=%u", handle, entry->sector);

	/* Zero out sectors */
	for (uint8_t s = 0; s < entry->sectors_used; s++) {
		memset(sd_sim[entry->sector + s], 0, SD_SECTOR_SIZE);
	}

	/* Reclaim if last allocation */
	if (entry->sector + entry->sectors_used == next_free_sector) {
		next_free_sector = entry->sector;
	}

	entry->valid = 0;
	entry->handle = 0;
	entry->sector = 0;
	entry->sectors_used = 0;

	return 0;
}
```

## src/sd_swap.h
```c
/*
 * Gigaspark OS - SD Swap Header
 * Block-level swap to SD card for compressed memory blobs
 */

#ifndef GIGASPARK_SD_SWAP_H
#define GIGASPARK_SD_SWAP_H

#include <stdint.h>
#include <stddef.h>

/*
 * Initialize the SD swap subsystem.
 *
 * Attempts to open the SD card via Zephyr disk_access API.
 * If no SD card is present, the module enters graceful degradation
 * mode (swap_enabled = false) and all operations return errors.
 *
 * @return  0 on success, -ENODEV if no SD card found.
 */
int swap_init(void);

/*
 * Write a compressed blob to the SD card.
 *
 * @param handle     The memory handle identifying this blob.
 * @param data       Compressed data to write.
 * @param data_len   Length of compressed data in bytes.
 * @return           Sector index on success, -1 on failure.
 */
int swap_write_blob(uint16_t handle, const uint8_t *data, uint16_t data_len);

/*
 * Read a compressed blob from the SD card.
 *
 * @param handle     The memory handle identifying this blob.
 * @param buf        Destination buffer.
 * @param buf_size   Size of destination buffer.
 * @return           Number of bytes read, or 0 on failure.
 */
size_t swap_read_blob(uint16_t handle, uint8_t *buf, size_t buf_size);

/*
 * Remove a blob from the SD swap table.
 *
 * @param handle  The memory handle to remove.
 * @return        0 on success, -1 if not found.
 */
int swap_remove_blob(uint16_t handle);

/*
 * Check if the SD swap subsystem is available.
 *
 * @return  true if SD card is initialized and ready.
 */
int swap_is_available(void);

#endif /* GIGASPARK_SD_SWAP_H */
```

## src/zram_comp.c
```c
/*
 * Gigaspark OS - zRAM Compression (Fase 16: LRU Eviction)
 *
 * Compresion RLE con politica de eviccion LRU (Least Recently Used).
 * Cada bloque comprimido lleva un timestamp de uso.
 * Cuando el zRAM se llena, se expulsa el bloque menos reciente.
 *
 * Formato RLE: pares [count][byte].
 *   - count: 1-255 (uint8_t)
 *   - byte:  el byte de datos
 *   - Un run de 300 bytes identicos = [255][byte] + [45][byte]
 *   - Un byte sin repeticion = [1][byte]
 *
 * Peor caso: datos sin runs -> expansion 2x.
 * Mejor caso: datos altamente repetitivos -> compresion ~1:255.
 */

#include "zram_comp.h"

#include <string.h>
#include <zephyr/logging/log.h>

LOG_MODULE_REGISTER(zram_comp, CONFIG_LOG_DEFAULT_LEVEL);

/* ============================================================
 * TABLA LRU - Timestamps de uso por bloque
 * ============================================================ */

#define ZRAM_MAX_BLOCKS    32     /* Maximo 32 bloques comprimidos */
#define ZRAM_BLOCK_SIZE    512    /* Tamano maximo de cada bloque comprimido */
#define ZRAM_TOTAL_SIZE    (ZRAM_MAX_BLOCKS * ZRAM_BLOCK_SIZE)  /* 16KB total */

/* Entrada en la tabla LRU */
struct zram_entry {
	uint32_t handle;        /* Handle del bloque original */
	uint32_t size_orig;     /* Tamano original */
	uint32_t size_comp;     /* Tamano comprimido */
	uint32_t lru_counter;   /* Contador de uso (mayor = mas reciente) */
	uint8_t  in_use;        /* 1 si la entrada esta ocupada */
	uint8_t  data[ZRAM_BLOCK_SIZE];  /* Datos comprimidos */
};

/* Tabla de entradas zRAM */
static struct zram_entry zram_table[ZRAM_MAX_BLOCKS];

/* Contador global LRU (se incrementa en cada acceso) */
static uint32_t lru_global_counter = 0;

/* Contador de bloques usados */
static uint8_t zram_used_count = 0;

/* ============================================================
 * FUNCIONES LRU
 * ============================================================ */

/*
 * Busca un bloque por su handle.
 * Retorna el indice en zram_table o -1 si no existe.
 */
static int lru_find(uint32_t handle)
{
	for (int i = 0; i < ZRAM_MAX_BLOCKS; i++) {
		if (zram_table[i].in_use && zram_table[i].handle == handle) {
			return i;
		}
	}
	return -1;
}

/*
 * Marca un bloque como "recien usado" (actualiza LRU counter).
 */
static void lru_touch(int index)
{
	zram_table[index].lru_counter = ++lru_global_counter;
}

/*
 * Encuentra la victima LRU (el bloque menos recientemente usado).
 * Retorna el indice de la victima, o -1 si no hay bloques.
 */
static int lru_find_victim(void)
{
	int victim = -1;
	uint32_t min_counter = UINT32_MAX;

	for (int i = 0; i < ZRAM_MAX_BLOCKS; i++) {
		if (zram_table[i].in_use) {
			if (zram_table[i].lru_counter < min_counter) {
				min_counter = zram_table[i].lru_counter;
				victim = i;
			}
		}
	}

	return victim;
}

/*
 * Expulsa (evict) el bloque menos recientemente usado.
 * Retorna el handle del bloque expulsado, o 0 si no hubo eviccion.
 */
static uint32_t lru_evict(void)
{
	int victim = lru_find_victim();

	if (victim < 0) {
		return 0;  /* No hay bloques para expulsar */
	}

	uint32_t evicted_handle = zram_table[victim].handle;

	LOG_WRN("LRU evict: handle=%u, size=%u, lru=%u",
		evicted_handle,
		zram_table[victim].size_comp,
		zram_table[victim].lru_counter);

	/* Liberar la entrada */
	zram_table[victim].in_use = 0;
	zram_used_count--;

	/* Notificar al motor de memoria que el bloque fue evictado */
	/* El caller debe usar mem_free() en el handle expulsado */
	return evicted_handle;
}

/*
 * Inserta un bloque comprimido en la tabla LRU.
 * Si la tabla esta llena, expulsa la victima primero.
 * Retorna 0 si ok, -1 si falla.
 */
static int lru_insert(uint32_t handle, const uint8_t *data,
		      uint32_t size_orig, uint32_t size_comp)
{
	/* Si ya existe, solo actualizar */
	int existing = lru_find(handle);
	if (existing >= 0) {
		memcpy(zram_table[existing].data, data, size_comp);
		zram_table[existing].size_orig = size_orig;
		zram_table[existing].size_comp = size_comp;
		lru_touch(existing);
		return 0;
	}

	/* Si esta lleno, expulsar victima */
	if (zram_used_count >= ZRAM_MAX_BLOCKS) {
		uint32_t evicted = lru_evict();
		if (evicted == 0) {
			return -1;  /* No se pudo expulsar */
		}
	}

	/* Buscar entrada libre */
	for (int i = 0; i < ZRAM_MAX_BLOCKS; i++) {
		if (!zram_table[i].in_use) {
			zram_table[i].handle = handle;
			zram_table[i].size_orig = size_orig;
			zram_table[i].size_comp = size_comp;
			zram_table[i].in_use = 1;
			memcpy(zram_table[i].data, data, size_comp);
			lru_touch(i);
			zram_used_count++;
			return 0;
		}
	}

	return -1;  /* No deberia llegar aqui */
}

/* ============================================================
 * FUNCIONES DE COMPRESION/DECOMPRESION RLE
 * ============================================================ */

size_t zram_compress(const uint8_t *src, size_t src_len,
		     uint8_t *dst, size_t dst_len)
{
	size_t si = 0;  /* source index */
	size_t di = 0;  /* destination index */

	while (si < src_len) {
		uint8_t current = src[si];
		uint8_t count = 1;

		/* Contar bytes identicos consecutivos */
		while (si + count < src_len &&
		       src[si + count] == current &&
		       count < 255) {
			count++;
		}

		/* Necesitamos 2 bytes para este run */
		if (di + 2 > dst_len) {
			return 0;  /* buffer overflow */
		}

		dst[di++] = count;
		dst[di++] = current;

		si += count;
	}

	return di;
}

size_t zram_decompress(const uint8_t *src, size_t src_len,
		       uint8_t *dst, size_t dst_len)
{
	size_t si = 0;  /* source index */
	size_t di = 0;  /* destination index */

	while (si + 1 < src_len) {
		uint8_t count = src[si];
		uint8_t byte  = src[si + 1];

		si += 2;

		/* Verificar espacio en buffer de salida */
		if (di + count > dst_len) {
			return 0;  /* buffer overflow */
		}

		/* Escribir 'count' copias de 'byte' */
		for (uint8_t i = 0; i < count; i++) {
			dst[di++] = byte;
		}
	}

	return di;
}

/* ============================================================
 * FUNCIONES PUBLICAS (API LRU + COMPRESION)
 * ============================================================ */

/*
 * Comprime un bloque y lo almacena en la tabla LRU.
 * Retorna el tamano comprimido, o 0 si falla.
 */
size_t zram_compress_and_store(uint32_t handle,
			       const uint8_t *src, size_t src_len)
{
	if (src_len > ZRAM_BLOCK_SIZE * 2) {
		return 0;  /* Bloque demasiado grande para RLE worst-case */
	}

	/* Buffer temporal para compresion */
	uint8_t compressed[ZRAM_BLOCK_SIZE];

	size_t comp_len = zram_compress(src, src_len, compressed, sizeof(compressed));

	if (comp_len == 0) {
		return 0;  /* Fallo la compresion o buffer overflow */
	}

	/* Almacenar en la tabla LRU */
	if (lru_insert(handle, compressed, src_len, comp_len) < 0) {
		return 0;  /* Fallo la insercion */
	}

	LOG_INF("zRAM store: handle=%u orig=%u comp=%u (%u%%)",
		handle, src_len, comp_len,
		(uint32_t)((comp_len * 100) / src_len));

	return comp_len;
}

/*
 * Recupera un bloque comprimido de la tabla LRU.
 * Actualiza el timestamp LRU.
 * Retorna el tamano descomprimido, o 0 si no existe.
 */
size_t zram_retrieve(uint32_t handle, uint8_t *dst, size_t dst_len)
{
	int idx = lru_find(handle);

	if (idx < 0) {
		return 0;  /* Bloque no encontrado en zRAM */
	}

	/* Actualizar LRU (fue recien usado) */
	lru_touch(idx);

	/* Descomprimir */
	size_t decomp_len = zram_decompress(zram_table[idx].data,
					    zram_table[idx].size_comp,
					    dst, dst_len);

	LOG_INF("zRAM retrieve: handle=%u comp=%u decomp=%u",
		handle, zram_table[idx].size_comp, decomp_len);

	return decomp_len;
}

/*
 * Expulsa explicitamente un bloque del zRAM.
 * Retorna el handle expulsado, o 0 si no se pudo.
 */
uint32_t zram_evict_block(uint32_t handle)
{
	int idx = lru_find(handle);

	if (idx < 0) {
		return 0;  /* No existe */
	}

	uint32_t evicted = zram_table[idx].handle;
	zram_table[idx].in_use = 0;
	zram_used_count--;

	return evicted;
}

/*
 * Retorna estadisticas del zRAM.
 */
void zram_get_stats(uint8_t *used, uint8_t *total, uint32_t *counter)
{
	if (used) {
		*used = zram_used_count;
	}
	if (total) {
		*total = ZRAM_MAX_BLOCKS;
	}
	if (counter) {
		*counter = lru_global_counter;
	}
}

void zram_reset(void)
{
	memset(zram_table, 0, sizeof(zram_table));
	lru_global_counter = 0;
	zram_used_count = 0;
}
```
