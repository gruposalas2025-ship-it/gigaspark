## Kconfig.sysbuild
```kconfig
# Copyright 2026 Gigaspark OS
# SPDX-License-Identifier: Apache-2.0

source "share/sysbuild/Kconfig"

config GIGASPARK_REMOTE_BOARD
string
	default "arduino_giga_r1/stm32h747xx/m4" if "$(BOARD)/$(BOARD_QUALIFIERS)" = "arduino_giga_r1/stm32h747xx/m7"
```

## build/Kconfig/boards/Kconfig
```kconfig
# Load Zephyr board Kconfig descriptions.
osource "/home/gabo/zephyr-ws/zephyr/boards/arduino/giga_r1/Kconfig"
```

## build/Kconfig/boards/Kconfig.defconfig
```kconfig
# Load Zephyr board defconfig descriptions.
osource "/home/gabo/zephyr-ws/zephyr/boards/arduino/giga_r1/Kconfig.defconfig"
```

## build/Kconfig/boards/Kconfig.sysbuild
```kconfig
# Load Sysbuild board Kconfig descriptions.
osource "/home/gabo/zephyr-ws/zephyr/boards/arduino/giga_r1/Kconfig.sysbuild"
```

## build/gigaspark_m4/Kconfig/arch/Kconfig.tmp
```kconfig
# Load Zephyr Arch Kconfig descriptions.
osource "/home/gabo/zephyr-ws/zephyr/arch/rx/Kconfig"
osource "/home/gabo/zephyr-ws/zephyr/arch/x86/Kconfig"
osource "/home/gabo/zephyr-ws/zephyr/arch/xtensa/Kconfig"
osource "/home/gabo/zephyr-ws/zephyr/arch/sparc/Kconfig"
osource "/home/gabo/zephyr-ws/zephyr/arch/riscv/Kconfig"
osource "/home/gabo/zephyr-ws/zephyr/arch/posix/Kconfig"
osource "/home/gabo/zephyr-ws/zephyr/arch/openrisc/Kconfig"
osource "/home/gabo/zephyr-ws/zephyr/arch/mips/Kconfig"
osource "/home/gabo/zephyr-ws/zephyr/arch/arm64/Kconfig"
osource "/home/gabo/zephyr-ws/zephyr/arch/arm/Kconfig"
osource "/home/gabo/zephyr-ws/zephyr/arch/arc/Kconfig"
```

## build/gigaspark_m4/Kconfig/boards/Kconfig.arduino_giga_r1
```kconfig
# Load board Kconfig descriptions.
osource "/home/gabo/zephyr-ws/zephyr/boards/arduino/giga_r1/Kconfig.arduino_giga_r1"
```

## build/gigaspark_m4/Kconfig/soc/Kconfig
```kconfig
# Load Zephyr SoC Kconfig descriptions.
osource "/home/gabo/zephyr-ws/zephyr/soc/xlnx/zynqmp/Kconfig"
osource "/home/gabo/zephyr-ws/zephyr/soc/xlnx/zynq7000/Kconfig"
osource "/home/gabo/zephyr-ws/zephyr/soc/xlnx/versalnet/Kconfig"
osource "/home/gabo/zephyr-ws/zephyr/soc/xlnx/versal2/Kconfig"
osource "/home/gabo/zephyr-ws/zephyr/soc/xlnx/versal/Kconfig"
osource "/home/gabo/zephyr-ws/zephyr/soc/xen/Kconfig"
osource "/home/gabo/zephyr-ws/zephyr/soc/wch/ch32v/Kconfig"
osource "/home/gabo/zephyr-ws/zephyr/soc/ti/simplelink/Kconfig"
osource "/home/gabo/zephyr-ws/zephyr/soc/ti/mspm0/Kconfig"
osource "/home/gabo/zephyr-ws/zephyr/soc/ti/lm3s6965/Kconfig"
osource "/home/gabo/zephyr-ws/zephyr/soc/ti/k3/Kconfig"
osource "/home/gabo/zephyr-ws/zephyr/soc/telink/tlsr/Kconfig"
osource "/home/gabo/zephyr-ws/zephyr/soc/syna/sr100/Kconfig"
osource "/home/gabo/zephyr-ws/zephyr/soc/starfive/jh71xx/Kconfig"
osource "/home/gabo/zephyr-ws/zephyr/soc/st/stm32/Kconfig"
osource "/home/gabo/zephyr-ws/zephyr/soc/snps/qemu_arc/Kconfig"
osource "/home/gabo/zephyr-ws/zephyr/soc/snps/nsim/arc_v/Kconfig"
osource "/home/gabo/zephyr-ws/zephyr/soc/snps/nsim/arc_classic/Kconfig"
osource "/home/gabo/zephyr-ws/zephyr/soc/snps/hsdk4xd/Kconfig"
osource "/home/gabo/zephyr-ws/zephyr/soc/snps/hsdk/Kconfig"
osource "/home/gabo/zephyr-ws/zephyr/soc/snps/emsk/Kconfig"
osource "/home/gabo/zephyr-ws/zephyr/soc/snps/emsdp/Kconfig"
osource "/home/gabo/zephyr-ws/zephyr/soc/snps/arc_iot/Kconfig"
osource "/home/gabo/zephyr-ws/zephyr/soc/silabs/Kconfig"
osource "/home/gabo/zephyr-ws/zephyr/soc/sifli/sf32/Kconfig"
osource "/home/gabo/zephyr-ws/zephyr/soc/sifive/sifive_freedom/Kconfig"
osource "/home/gabo/zephyr-ws/zephyr/soc/sensry/Kconfig"
osource "/home/gabo/zephyr-ws/zephyr/soc/rockchip/Kconfig"
osource "/home/gabo/zephyr-ws/zephyr/soc/renode/riscv_virtual/Kconfig"
osource "/home/gabo/zephyr-ws/zephyr/soc/renode/cortex_r8_virtual/Kconfig"
osource "/home/gabo/zephyr-ws/zephyr/soc/renesas/smartbond/Kconfig"
osource "/home/gabo/zephyr-ws/zephyr/soc/renesas/rz/Kconfig"
osource "/home/gabo/zephyr-ws/zephyr/soc/renesas/rx/Kconfig"
osource "/home/gabo/zephyr-ws/zephyr/soc/renesas/rcar/Kconfig"
osource "/home/gabo/zephyr-ws/zephyr/soc/renesas/ra/Kconfig"
osource "/home/gabo/zephyr-ws/zephyr/soc/realtek/fingerprint/Kconfig"
osource "/home/gabo/zephyr-ws/zephyr/soc/realtek/ec/Kconfig"
osource "/home/gabo/zephyr-ws/zephyr/soc/realtek/bee/Kconfig"
osource "/home/gabo/zephyr-ws/zephyr/soc/realtek/ameba/Kconfig"
osource "/home/gabo/zephyr-ws/zephyr/soc/raspberrypi/rpi_pico/Kconfig"
osource "/home/gabo/zephyr-ws/zephyr/soc/quicklogic/eos_s3/Kconfig"
osource "/home/gabo/zephyr-ws/zephyr/soc/qemu/virt_riscv/Kconfig"
osource "/home/gabo/zephyr-ws/zephyr/soc/qemu/or1k/Kconfig"
osource "/home/gabo/zephyr-ws/zephyr/soc/qemu/malta/Kconfig"
osource "/home/gabo/zephyr-ws/zephyr/soc/openisa/rv32m1/Kconfig"
osource "/home/gabo/zephyr-ws/zephyr/soc/openhwgroup/cva6/Kconfig"
osource "/home/gabo/zephyr-ws/zephyr/soc/oct/osd32mp15x/Kconfig"
osource "/home/gabo/zephyr-ws/zephyr/soc/nxp/s32/Kconfig"
osource "/home/gabo/zephyr-ws/zephyr/soc/nxp/rw/Kconfig"
osource "/home/gabo/zephyr-ws/zephyr/soc/nxp/mcx/Kconfig"
osource "/home/gabo/zephyr-ws/zephyr/soc/nxp/lpc/Kconfig"
osource "/home/gabo/zephyr-ws/zephyr/soc/nxp/layerscape/Kconfig"
osource "/home/gabo/zephyr-ws/zephyr/soc/nxp/kinetis/Kconfig"
osource "/home/gabo/zephyr-ws/zephyr/soc/nxp/imxrt/Kconfig"
osource "/home/gabo/zephyr-ws/zephyr/soc/nxp/imx/Kconfig"
osource "/home/gabo/zephyr-ws/zephyr/soc/nuvoton/numicro/Kconfig"
osource "/home/gabo/zephyr-ws/zephyr/soc/nuvoton/numaker/Kconfig"
osource "/home/gabo/zephyr-ws/zephyr/soc/nuvoton/npcx/Kconfig"
osource "/home/gabo/zephyr-ws/zephyr/soc/nuvoton/npcm/Kconfig"
osource "/home/gabo/zephyr-ws/zephyr/soc/nordic/Kconfig"
osource "/home/gabo/zephyr-ws/zephyr/soc/neorv32/Kconfig"
osource "/home/gabo/zephyr-ws/zephyr/soc/native/inf_clock/Kconfig"
osource "/home/gabo/zephyr-ws/zephyr/soc/microchip/sam/sama7/Kconfig"
osource "/home/gabo/zephyr-ws/zephyr/soc/microchip/sam/sam_d5x_e5x/Kconfig"
osource "/home/gabo/zephyr-ws/zephyr/soc/microchip/pic64/Kconfig"
osource "/home/gabo/zephyr-ws/zephyr/soc/microchip/pic32c/pic32cz_ca/Kconfig"
osource "/home/gabo/zephyr-ws/zephyr/soc/microchip/pic32c/pic32cx_sg/Kconfig"
osource "/home/gabo/zephyr-ws/zephyr/soc/microchip/pic32c/pic32cm_pl/Kconfig"
osource "/home/gabo/zephyr-ws/zephyr/soc/microchip/pic32c/pic32cm_jh/Kconfig"
osource "/home/gabo/zephyr-ws/zephyr/soc/microchip/miv/Kconfig"
osource "/home/gabo/zephyr-ws/zephyr/soc/microchip/mec/Kconfig"
osource "/home/gabo/zephyr-ws/zephyr/soc/mediatek/mt8xxx/Kconfig"
osource "/home/gabo/zephyr-ws/zephyr/soc/lowrisc/opentitan/Kconfig"
osource "/home/gabo/zephyr-ws/zephyr/soc/litex/litex_vexriscv/Kconfig"
osource "/home/gabo/zephyr-ws/zephyr/soc/ite/ec/Kconfig"
osource "/home/gabo/zephyr-ws/zephyr/soc/intel/wildcat_lake/Kconfig"
osource "/home/gabo/zephyr-ws/zephyr/soc/intel/raptor_lake/Kconfig"
osource "/home/gabo/zephyr-ws/zephyr/soc/intel/panther_lake/Kconfig"
osource "/home/gabo/zephyr-ws/zephyr/soc/intel/lakemont/Kconfig"
osource "/home/gabo/zephyr-ws/zephyr/soc/intel/intel_socfpga_std/Kconfig"
osource "/home/gabo/zephyr-ws/zephyr/soc/intel/intel_socfpga/Kconfig"
osource "/home/gabo/zephyr-ws/zephyr/soc/intel/intel_niosv/Kconfig"
osource "/home/gabo/zephyr-ws/zephyr/soc/intel/intel_ish/Kconfig"
osource "/home/gabo/zephyr-ws/zephyr/soc/intel/intel_adsp/Kconfig"
osource "/home/gabo/zephyr-ws/zephyr/soc/intel/elkhart_lake/Kconfig"
osource "/home/gabo/zephyr-ws/zephyr/soc/intel/atom/Kconfig"
osource "/home/gabo/zephyr-ws/zephyr/soc/intel/apollo_lake/Kconfig"
osource "/home/gabo/zephyr-ws/zephyr/soc/intel/alder_lake/Kconfig"
osource "/home/gabo/zephyr-ws/zephyr/soc/infineon/psoc4/Kconfig"
osource "/home/gabo/zephyr-ws/zephyr/soc/infineon/edge/Kconfig"
osource "/home/gabo/zephyr-ws/zephyr/soc/infineon/cat3/Kconfig"
osource "/home/gabo/zephyr-ws/zephyr/soc/infineon/cat1c/Kconfig"
osource "/home/gabo/zephyr-ws/zephyr/soc/infineon/cat1b/Kconfig"
osource "/home/gabo/zephyr-ws/zephyr/soc/infineon/cat1a/Kconfig"
osource "/home/gabo/zephyr-ws/zephyr/soc/gd/gd32/Kconfig"
osource "/home/gabo/zephyr-ws/zephyr/soc/gaisler/leon3/Kconfig"
osource "/home/gabo/zephyr-ws/zephyr/soc/gaisler/gr716a/Kconfig"
osource "/home/gabo/zephyr-ws/zephyr/soc/focaltech/Kconfig"
osource "/home/gabo/zephyr-ws/zephyr/soc/espressif/Kconfig"
osource "/home/gabo/zephyr-ws/zephyr/soc/ene/kb1200/Kconfig"
osource "/home/gabo/zephyr-ws/zephyr/soc/ene/kb106x/Kconfig"
osource "/home/gabo/zephyr-ws/zephyr/soc/elan/em32f967/Kconfig"
osource "/home/gabo/zephyr-ws/zephyr/soc/egis/Kconfig"
osource "/home/gabo/zephyr-ws/zephyr/soc/efinix/sapphire/Kconfig"
osource "/home/gabo/zephyr-ws/zephyr/soc/cdns/xtensa_sample_controller/Kconfig"
osource "/home/gabo/zephyr-ws/zephyr/soc/cdns/swerv/Kconfig"
osource "/home/gabo/zephyr-ws/zephyr/soc/cdns/sample_controller32/Kconfig"
osource "/home/gabo/zephyr-ws/zephyr/soc/cdns/dc233c/Kconfig"
osource "/home/gabo/zephyr-ws/zephyr/soc/brcm/bcmvk/Kconfig"
osource "/home/gabo/zephyr-ws/zephyr/soc/brcm/bcm2712/Kconfig"
osource "/home/gabo/zephyr-ws/zephyr/soc/brcm/bcm2711/Kconfig"
osource "/home/gabo/zephyr-ws/zephyr/soc/blackberry/qnxhv_vm/Kconfig"
osource "/home/gabo/zephyr-ws/zephyr/soc/bflb/Kconfig"
osource "/home/gabo/zephyr-ws/zephyr/soc/atmel/sam0/Kconfig"
osource "/home/gabo/zephyr-ws/zephyr/soc/atmel/sam/Kconfig"
osource "/home/gabo/zephyr-ws/zephyr/soc/aspeed/Kconfig"
osource "/home/gabo/zephyr-ws/zephyr/soc/arm/Kconfig"
osource "/home/gabo/zephyr-ws/zephyr/soc/arm/beetle/Kconfig"
osource "/home/gabo/zephyr-ws/zephyr/soc/antmicro/myra/Kconfig"
osource "/home/gabo/zephyr-ws/zephyr/soc/andestech/Kconfig"
osource "/home/gabo/zephyr-ws/zephyr/soc/amd/acp_6_0/Kconfig"
osource "/home/gabo/zephyr-ws/zephyr/soc/ambiq/Kconfig"
osource "/home/gabo/zephyr-ws/zephyr/soc/allwinner/sun8i_h3/Kconfig"
osource "/home/gabo/zephyr-ws/zephyr/soc/alif/ensemble/Kconfig"
osource "/home/gabo/zephyr-ws/zephyr/soc/aesc/Kconfig"
osource "/home/gabo/zephyr-ws/zephyr/soc/adi/max32/Kconfig"
```
